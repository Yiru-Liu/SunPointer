#include <Stepper.h>

#define BAUD_RATE 115200

#define STEPPER_SPEED 5

#define RX_PIN 4
#define TX_PIN 3

#define STEPS_PER_REVOLUTION 2038
#define COMPLETE_REVOLUTION 6170
#define IN1 5 
#define IN2 6
#define IN3 7
#define IN4 8

#define RED_PIN 9
#define GRN_PIN 10
#define BLU_PIN 11

#define DEG_TO_RAD 0.017453292519943295769236907684886

Stepper myStepper = Stepper(STEPS_PER_REVOLUTION, IN1, IN3, IN2, IN4);

//night = 32,0,255
//
//
//
//1000 K: red orange = 255,16,0
//
//1800 K: true orange = 255,96,0
//
//3300 K: yellow orange = 255,100,8
//
//
//
//6300 K: true white
//
//10000 K: bluish white

struct RGBColor {
  byte red;
  byte green;
  byte blue;
};

struct CelestialCoords {
  float ra;
  float dec;
};

// Data from http://www.vendian.org/mncharity/dir3/blackbody/UnstableURLs/bbr_color.html
const RGBColor COLOR_TEMPS[] = {
  {255,56,0},
  {255,71,0},
  {255,83,0},
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  {155,188,255}
};

constexpr size_t COLOR_TEMPS_SIZE = sizeof(COLOR_TEMPS) / sizeof(COLOR_TEMPS[0]);

RGBColor tempToRGB(int temp) {
  int index = (temp - 1000) / 100;
  if (index < 0) {
    index = 0;
  } else if (index >= COLOR_TEMPS_SIZE) {
    index = COLOR_TEMPS_SIZE - 1;
  }

  return COLOR_TEMPS[index];
}

float toJdSince2000(int year, byte month, byte day, byte hour, byte minute, byte second) {
  // Algorithm from https://aa.usno.navy.mil/faq/JD_formula
  return (367 * year - (7*(year + (month + 9)/12))/4 + (275*month)/9 + day) - 730531.5
    + (hour + minute*60 + second*3600)/86400.0;
}

CelestialCoords calculateSun(float jdSince2000) {
  // Algorithm from https://aa.usno.navy.mil/faq/sun_approx
  float g = fmod(357.529 + 0.98560028 * jdSince2000, 360) * DEG_TO_RAD;
  float q = fmod(280.459 + 0.98564736 * jdSince2000, 360) * DEG_TO_RAD;
  float l = q + ((1.915 * sin(g) + 0.020 * sin(2*g)) * DEG_TO_RAD);
  float e = (23.439 - 0.00000036 * jdSince2000) * DEG_TO_RAD;
  float ra = atan2(cos(e) * sin(l), cos(l));
  float d = asin(sin(e) * sin(l));
  CelestialCoords c = {ra, d};
  return c;
}

// Elevation to temperature (K): [elevation (radians)] * 5729.5779513082320876798154814105 + 1000

void writeColor(RGBColor color) {
  analogWrite(RED_PIN, color.red);
  analogWrite(GRN_PIN, color.green / 3);
  analogWrite(BLU_PIN, color.blue / 3);
}

void setup() {
  pinMode(RED_PIN, OUTPUT);
  pinMode(GRN_PIN, OUTPUT);
  pinMode(BLU_PIN, OUTPUT);

  Serial.begin(BAUD_RATE);
  Serial.println("Serial ready.");

	myStepper.setSpeed(STEPPER_SPEED);
}

void makeSteps(int numSteps) {
  myStepper.step(numSteps);
}

/* Commands:
 * A[x] - Advance stepper motor by [x] steps
 * X[hex code] - Sets the LED to the given hex code
 */
void processSerial() {
  if (Serial.available() > 0) {
    char incomingByte = Serial.read();
    if (incomingByte == 'X') {
      Serial.println("X - CHANGE COLOR");
      String strInput = Serial.readStringUntil('\n');
      if (strInput != NULL) {
        char hexCode[7] = {};
        strInput.toCharArray(hexCode, 7);
        unsigned long hexColor = strtoul(hexCode, NULL, 16);
        RGBColor rgbcolor = {
          hexColor >> 16,
          (hexColor >> 8) & 0xFF,
          hexColor & 0xFF
        };
        Serial.print("Displaying color ");
        Serial.print(rgbcolor.red);
        Serial.print(',');
        Serial.print(rgbcolor.green);
        Serial.print(',');
        Serial.print(rgbcolor.blue);
        Serial.println('.');
        writeColor(rgbcolor);
      } else {
        Serial.println("Error parsing command.");
      }
    } else if (incomingByte == 'A') {
      Serial.println("A - ADVANCE STEPPER");
      int numSteps = Serial.parseInt();
      Serial.print("Advancing ");
      Serial.print(numSteps);
      Serial.print(" steps... ");
      if (Serial.read() == '\n') {
        makeSteps(numSteps);
        Serial.println("Done.");
      } else {
        Serial.println("Error parsing command.");
      }
    } else {
      Serial.print("Unrecognized command: ");
      Serial.println(incomingByte);
      while (Serial.read() != '\n') {} // Consume the rest of the line
    }
  }
}

void loop() {
  processSerial();
  // while (Serial.available() > 0) {
  //   int temp = Serial.parseInt();
  //   if (Serial.read() == '\n') {
  //     Serial.print("Temp: ");
  //     Serial.print(temp);
  //     RGBColor currentColor = tempToRGB(temp);
  //     Serial.print("\tColor: ");
  //     Serial.print(currentColor.red);
  //     Serial.print(", ");
  //     Serial.print(currentColor.green);
  //     Serial.print(", ");
  //     Serial.println(currentColor.blue);
  //     writeColor(currentColor);
  //   }
  // }
}
